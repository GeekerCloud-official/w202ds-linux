## Devices/drm/source/backlight/Kconfig
```kconfig
config W202DS_BACKLIGHT
	tristate "W202DS deferred PWM backlight"
	depends on ARCH_SPRD && BACKLIGHT_CLASS_DEVICE && PWM_SPRD
	help
	  Preserve inherited PWM until /dev/w202blctl is explicitly attached.
	  Keep built-in when userspace expects this interface before modules load.
```

## Devices/drm/source/boot-display/Kconfig
```kconfig
config W202_PJB_CONSOLE
	bool "W202DS retained boot display log"
	depends on ARM64 && OF && COMMON_CLK
	select APERTURE_HELPERS
	select FONT_SUPPORT
	select FONT_8x16
	help
	  Print in the validated boot-display rectangle and hold its clocks
	  until a native display driver removes the firmware aperture.
```

## Devices/drm/source/legacy-fbcon/Kconfig
```kconfig
config W202DS_LKFB_CONSOLE
	bool "W202DS legacy deferred diagnostic framebuffer"
	depends on ARCH_SPRD && FB
	select FB_SYSMEM_HELPERS
	help
	  Optional legacy /dev/w202fbcon interface; not the normal DRM path.
	  Does not attach the inherited framebuffer until an explicit ioctl.
```

## Devices/drm/source/pj4edk-boot-display/Kconfig
```kconfig
config PJ4EDK_BOOT_DISPLAY
	bool "pj4edk-boot-display retained boot logs (W202DS)"
	depends on ARM64 && OF && COMMON_CLK
	select APERTURE_HELPERS
	select FONT_SUPPORT
	select FONT_8x16
	help
	  Print in the validated boot-display rectangle and hold its clocks
	  until a native display driver removes the firmware aperture.
```

## Devices/pmic/source/diagnostic-recovery/Kconfig
```kconfig
config W202DS_DIAG_RECOVERY
	bool "W202DS UMP9620 diagnostic recovery control"
	depends on ARM64 && ARCH_SPRD
	help
	  Keep /dev/w202diagctl cancel/rearm ioctls and the explicit emergency
	  fastboot fallback. This is a diagnostic policy, not a hardware watchdog.

config W202DS_DIAG_BOOT_TIMEOUT
	int "Initial diagnostic recovery timeout (seconds, zero disables)"
	depends on W202DS_DIAG_RECOVERY
	range 0 600
	default 0
	help
	  Normal configurations leave this at zero. The imported diagnostic
	  Server profile explicitly retains 120 seconds and userspace cancellation.
```

## Devices/usb3/source/legacy-phy/Kconfig
```kconfig
config USB_W202DS_DUMMY_PHY
	tristate "W202DS legacy USB2 PHY compatibility"
	depends on ARCH_SPRD && USB_PHY && OF
	help
	  Supply the legacy usb-phy phandle expected by the board's DWC3.
	  Keep built-in for early USB; module mode is for isolated tests.
```
